## config/boards/arm/noru64/Kconfig
```kconfig
config BOARD
	default "noru64_v1_single" if BOARD_NORU64_V1_SINGLE
	default "noru64_v1_left" if BOARD_NORU64_V1_LEFT
	default "noru64_v1_right" if BOARD_NORU64_V1_RIGHT

config BOARD_ENABLE_DCDC
	bool "Enable DCDC mode"
	select SOC_DCDC_NRF52X
	default y
	depends on (BOARD_NORU64_V1_LEFT || BOARD_NORU64_V1_RIGHT || BOARD_NORU64_V1_SINGLE)
```
